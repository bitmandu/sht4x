## components/sht4x/Kconfig.projbuild
```kconfig
menu "sht4x"

    config SHT4X_ADDRESS
        hex "SHT4X I2C Address"
        default 0x44
        help
            SHT4x I2C device address.

    config SHT4X_NUM_RETRY
        int "Number of retry attempts"
        range 0 100
        default 3
        help
            Number of times to retry reading sensor data before returning an error.

    config SHT4X_RETRY_DELAY_MS
        int "Time delay [ms] between retry attempts"
        default 10
        help
            Time (in ms) to wait between retry attempts.

endmenu
```
